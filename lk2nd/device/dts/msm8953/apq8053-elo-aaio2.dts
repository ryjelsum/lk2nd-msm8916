// SPDX-License-Identifier: GPL-2.0-only
 
#include <skeleton64.dtsi>
#include <lk2nd.dtsi>

/ {
	qcom,msm-id = <QCOM_ID_APQ8053 0>;
	qcom,board-id =  <0x00530208 0>;
};

&lk2nd {
	model = "Elo I-Series Android AIO 2.0";
	compatible = "qcom,apq8053-mtp", "qcom,apq8053", "qcom,mtp";
	lk2nd,dtb-files = "apq8053-elo-aaio2";
};
